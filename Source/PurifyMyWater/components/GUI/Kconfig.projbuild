## Source/PurifyMyWater/components/GUI/Kconfig.projbuild
```kconfig
menu "PurifyMyWater GUI Configuration"

    choice DEVICE_SELECTED
		default PMW_DEVICE_NONE
        prompt "Select the device"
		config PMW_DEVICE_NONE
			bool "Select a supported device"

        config DEVICE_WT32_SC01
            bool "Wireless-Tag WT32-SC01 - SPI"
            help
                Select this if you are using a WT32-SC01 device.

                The corresponding CSV file in the PurifyMyWater Device Configuration directory is
                partitions/partition-16MB.csv

        config DEVICE_WT32_SC01_PLUS
            bool "Wireless-Tag WT32-SC01-Plus - 8Bit Parallel"
            help
                Select this if you are using a WT32-SC01-Plus device.

                The corresponding CSV file in the PurifyMyWater Device Configuration directory is
                partitions/partition-16MB.csv
    endchoice

endmenu
```

## Source/PurifyMyWater/components/LogUtils/Kconfig.projbuild
```kconfig
menu "PurifyMyWater Logging Configuration"

    choice LOG_DEFAULT_LEVEL
        bool "Default log verbosity"
        default LOG_DEFAULT_LEVEL_INFO
        help
            Specify how much output to see in logs by default.
            You can set lower verbosity level at runtime using
            esp_log_level_set function.

            By default, this setting limits which log statements
            are compiled into the program. For example, selecting
            "Warning" would mean that changing log level to "Debug"
            at runtime will not be possible. To allow increasing log
            level above the default at runtime, see the next option.

        config LOG_DEFAULT_LEVEL_NONE
            bool "No output"
        config LOG_DEFAULT_LEVEL_ERROR
            bool "Error"
        config LOG_DEFAULT_LEVEL_WARN
            bool "Warning"
        config LOG_DEFAULT_LEVEL_INFO
            bool "Info"
        config LOG_DEFAULT_LEVEL_DEBUG
            bool "Debug"
        config LOG_DEFAULT_LEVEL_VERBOSE
            bool "Verbose"
    endchoice

    config LOG_DEFAULT_LEVEL
        int
        default 0 if LOG_DEFAULT_LEVEL_NONE
        default 1 if LOG_DEFAULT_LEVEL_ERROR
        default 2 if LOG_DEFAULT_LEVEL_WARN
        default 3 if LOG_DEFAULT_LEVEL_INFO
        default 4 if LOG_DEFAULT_LEVEL_DEBUG
        default 5 if LOG_DEFAULT_LEVEL_VERBOSE

    choice LOG_MAXIMUM_LEVEL
        bool "Maximum log verbosity"
        default LOG_MAXIMUM_EQUALS_DEFAULT
        help
            This config option sets the highest log verbosity that it's possible to select
            at runtime by calling esp_log_level_set(). This level may be higher than
            the default verbosity level which is set when the app starts up.

            This can be used enable debugging output only at a critical point, for a particular
            tag, or to minimize startup time but then enable more logs once the firmware has
            loaded.

            Note that increasing the maximum available log level will increase the firmware
            binary size.

            This option only applies to logging from the app, the bootloader log level is
            fixed at compile time to the separate "Bootloader log verbosity" setting.

        config LOG_MAXIMUM_EQUALS_DEFAULT
            bool "Same as default"
        config LOG_MAXIMUM_LEVEL_ERROR
            bool "Error"
            depends on LOG_DEFAULT_LEVEL < 1
        config LOG_MAXIMUM_LEVEL_WARN
            bool "Warning"
            depends on LOG_DEFAULT_LEVEL < 2
        config LOG_MAXIMUM_LEVEL_INFO
            bool "Info"
            depends on LOG_DEFAULT_LEVEL < 3
        config LOG_MAXIMUM_LEVEL_DEBUG
            bool "Debug"
            depends on LOG_DEFAULT_LEVEL < 4
        config LOG_MAXIMUM_LEVEL_VERBOSE
            bool "Verbose"
            depends on LOG_DEFAULT_LEVEL < 5
    endchoice

    config LOG_MAXIMUM_LEVEL
        int
        default LOG_DEFAULT_LEVEL if LOG_MAXIMUM_EQUALS_DEFAULT
        default 0 if LOG_MAXIMUM_LEVEL_NONE
        default 1 if LOG_MAXIMUM_LEVEL_ERROR
        default 2 if LOG_MAXIMUM_LEVEL_WARN
        default 3 if LOG_MAXIMUM_LEVEL_INFO
        default 4 if LOG_MAXIMUM_LEVEL_DEBUG
        default 5 if LOG_MAXIMUM_LEVEL_VERBOSE

    choice LOG_DEFAULT_LEVEL_PMW
        bool "PurifyMyWater modules default log verbosity"
        default LOG_DEFAULT_LEVEL_PMW_EQUALS_DEFAULT
        help
            Specify how much output to see in logs by default in all the PurifyMyWater modules.

        config LOG_DEFAULT_LEVEL_PMW_EQUALS_DEFAULT
            bool "Same as default"
        config LOG_DEFAULT_LEVEL_PMW_NONE
            bool "No output"
        config LOG_DEFAULT_LEVEL_PMW_ERROR
            bool "Error"
            depends on LOG_MAXIMUM_LEVEL >= 1
        config LOG_DEFAULT_LEVEL_PMW_WARN
            bool "Warning"
            depends on LOG_MAXIMUM_LEVEL >= 2
        config LOG_DEFAULT_LEVEL_PMW_INFO
            bool "Info"
            depends on LOG_MAXIMUM_LEVEL >= 3
        config LOG_DEFAULT_LEVEL_PMW_DEBUG
            bool "Debug"
            depends on LOG_MAXIMUM_LEVEL >= 4
        config LOG_DEFAULT_LEVEL_PMW_VERBOSE
            bool "Verbose"
            depends on LOG_MAXIMUM_LEVEL >= 5

    endchoice

    config LOG_DEFAULT_LEVEL_PMW
            int
            default LOG_DEFAULT_LEVEL if LOG_DEFAULT_LEVEL_PMW_EQUALS_DEFAULT
            default 0 if LOG_DEFAULT_LEVEL_PMW_NONE
            default 1 if LOG_DEFAULT_LEVEL_PMW_ERROR
            default 2 if LOG_DEFAULT_LEVEL_PMW_WARN
            default 3 if LOG_DEFAULT_LEVEL_PMW_INFO
            default 4 if LOG_DEFAULT_LEVEL_PMW_DEBUG
            default 5 if LOG_DEFAULT_LEVEL_PMW_VERBOSE

    choice LOG_DEFAULT_LEVEL_BOOT
            bool "Boot module log verbosity"
            default LOG_DEFAULT_LEVEL_BOOT_EQUALS_DEFAULT
            help
                Specify how much output to see in logs by default in the boot module.

            config LOG_DEFAULT_LEVEL_BOOT_EQUALS_DEFAULT
                bool "Same as PurifyMyWater default"
            config LOG_DEFAULT_LEVEL_BOOT_NONE
                bool "No output"
            config LOG_DEFAULT_LEVEL_BOOT_ERROR
                bool "Error"
                depends on LOG_MAXIMUM_LEVEL >= 1
            config LOG_DEFAULT_LEVEL_BOOT_WARN
                bool "Warning"
                depends on LOG_MAXIMUM_LEVEL >= 2
            config LOG_DEFAULT_LEVEL_BOOT_INFO
                bool "Info"
                depends on LOG_MAXIMUM_LEVEL >= 3
            config LOG_DEFAULT_LEVEL_BOOT_DEBUG
                bool "Debug"
                depends on LOG_MAXIMUM_LEVEL >= 4
            config LOG_DEFAULT_LEVEL_BOOT_VERBOSE
                bool "Verbose"
                depends on LOG_MAXIMUM_LEVEL >= 5

        endchoice

        config LOG_DEFAULT_LEVEL_BOOT
                int
                default LOG_DEFAULT_LEVEL_PMW if LOG_DEFAULT_LEVEL_BOOT_EQUALS_DEFAULT
                default 0 if LOG_DEFAULT_LEVEL_BOOT_NONE
                default 1 if LOG_DEFAULT_LEVEL_BOOT_ERROR
                default 2 if LOG_DEFAULT_LEVEL_BOOT_WARN
                default 3 if LOG_DEFAULT_LEVEL_BOOT_INFO
                default 4 if LOG_DEFAULT_LEVEL_BOOT_DEBUG
                default 5 if LOG_DEFAULT_LEVEL_BOOT_VERBOSE

    choice LOG_DEFAULT_LEVEL_BOOT_GUI
            bool "Boot GUI module log verbosity"
            default LOG_DEFAULT_LEVEL_BOOT_GUI_EQUALS_DEFAULT
            help
                Specify how much output to see in logs by default in the boot GUI module.

            config LOG_DEFAULT_LEVEL_BOOT_GUI_EQUALS_DEFAULT
                bool "Same as PurifyMyWater default"
            config LOG_DEFAULT_LEVEL_BOOT_GUI_NONE
                bool "No output"
            config LOG_DEFAULT_LEVEL_BOOT_GUI_ERROR
                bool "Error"
                depends on LOG_MAXIMUM_LEVEL >= 1
            config LOG_DEFAULT_LEVEL_BOOT_GUI_WARN
                bool "Warning"
                depends on LOG_MAXIMUM_LEVEL >= 2
            config LOG_DEFAULT_LEVEL_BOOT_GUI_INFO
                bool "Info"
                depends on LOG_MAXIMUM_LEVEL >= 3
            config LOG_DEFAULT_LEVEL_BOOT_GUI_DEBUG
                bool "Debug"
                depends on LOG_MAXIMUM_LEVEL >= 4
            config LOG_DEFAULT_LEVEL_BOOT_GUI_VERBOSE
                bool "Verbose"
                depends on LOG_MAXIMUM_LEVEL >= 5

        endchoice

        config LOG_DEFAULT_LEVEL_BOOT_GUI
                int
                default LOG_DEFAULT_LEVEL_PMW if LOG_DEFAULT_LEVEL_BOOT_GUI_EQUALS_DEFAULT
                default 0 if LOG_DEFAULT_LEVEL_BOOT_GUI_NONE
                default 1 if LOG_DEFAULT_LEVEL_BOOT_GUI_ERROR
                default 2 if LOG_DEFAULT_LEVEL_BOOT_GUI_WARN
                default 3 if LOG_DEFAULT_LEVEL_BOOT_GUI_INFO
                default 4 if LOG_DEFAULT_LEVEL_BOOT_GUI_DEBUG
                default 5 if LOG_DEFAULT_LEVEL_BOOT_GUI_VERBOSE

        choice LOG_DEFAULT_LEVEL_GUI
                bool "GUI module log verbosity"
                default LOG_DEFAULT_LEVEL_GUI_EQUALS_DEFAULT
                help
                    Specify how much output to see in logs by default in the GUI module.

                config LOG_DEFAULT_LEVEL_GUI_EQUALS_DEFAULT
                    bool "Same as PurifyMyWater default"
                config LOG_DEFAULT_LEVEL_GUI_NONE
                    bool "No output"
                config LOG_DEFAULT_LEVEL_GUI_ERROR
                    bool "Error"
                    depends on LOG_MAXIMUM_LEVEL >= 1
                config LOG_DEFAULT_LEVEL_GUI_WARN
                    bool "Warning"
                    depends on LOG_MAXIMUM_LEVEL >= 2
                config LOG_DEFAULT_LEVEL_GUI_INFO
                    bool "Info"
                    depends on LOG_MAXIMUM_LEVEL >= 3
                config LOG_DEFAULT_LEVEL_GUI_DEBUG
                    bool "Debug"
                    depends on LOG_MAXIMUM_LEVEL >= 4
                config LOG_DEFAULT_LEVEL_GUI_VERBOSE
                    bool "Verbose"
                    depends on LOG_MAXIMUM_LEVEL >= 5

            endchoice

            config LOG_DEFAULT_LEVEL_GUI
                    int
                    default LOG_DEFAULT_LEVEL_PMW if LOG_DEFAULT_LEVEL_GUI_EQUALS_DEFAULT
                    default 0 if LOG_DEFAULT_LEVEL_GUI_NONE
                    default 1 if LOG_DEFAULT_LEVEL_GUI_ERROR
                    default 2 if LOG_DEFAULT_LEVEL_GUI_WARN
                    default 3 if LOG_DEFAULT_LEVEL_GUI_INFO
                    default 4 if LOG_DEFAULT_LEVEL_GUI_DEBUG
                    default 5 if LOG_DEFAULT_LEVEL_GUI_VERBOSE

        choice LOG_DEFAULT_LEVEL_SETTINGS_STORAGE
                bool "Settings Storage module log verbosity"
                default LOG_DEFAULT_LEVEL_SETTINGS_STORAGE_EQUALS_DEFAULT
                help
                    Specify how much output to see in logs by default in the Settings Storage module.

                config LOG_DEFAULT_LEVEL_SETTINGS_STORAGE_EQUALS_DEFAULT
                    bool "Same as PurifyMyWater default"
                config LOG_DEFAULT_LEVEL_SETTINGS_STORAGE_NONE
                    bool "No output"
                config LOG_DEFAULT_LEVEL_SETTINGS_STORAGE_ERROR
                    bool "Error"
                    depends on LOG_MAXIMUM_LEVEL >= 1
                config LOG_DEFAULT_LEVEL_SETTINGS_STORAGE_WARN
                    bool "Warning"
                    depends on LOG_MAXIMUM_LEVEL >= 2
                config LOG_DEFAULT_LEVEL_SETTINGS_STORAGE_INFO
                    bool "Info"
                    depends on LOG_MAXIMUM_LEVEL >= 3
                config LOG_DEFAULT_LEVEL_SETTINGS_STORAGE_DEBUG
                    bool "Debug"
                    depends on LOG_MAXIMUM_LEVEL >= 4
                config LOG_DEFAULT_LEVEL_SETTINGS_STORAGE_VERBOSE
                    bool "Verbose"
                    depends on LOG_MAXIMUM_LEVEL >= 5

            endchoice

            config LOG_DEFAULT_LEVEL_SETTINGS_STORAGE
                    int
                    default LOG_DEFAULT_LEVEL_PMW if LOG_DEFAULT_LEVEL_SETTINGS_STORAGE_EQUALS_DEFAULT
                    default 0 if LOG_DEFAULT_LEVEL_SETTINGS_STORAGE_NONE
                    default 1 if LOG_DEFAULT_LEVEL_SETTINGS_STORAGE_ERROR
                    default 2 if LOG_DEFAULT_LEVEL_SETTINGS_STORAGE_WARN
                    default 3 if LOG_DEFAULT_LEVEL_SETTINGS_STORAGE_INFO
                    default 4 if LOG_DEFAULT_LEVEL_SETTINGS_STORAGE_DEBUG
                    default 5 if LOG_DEFAULT_LEVEL_SETTINGS_STORAGE_VERBOSE

            choice LOG_DEFAULT_LEVEL_STORAGE_PARTITION_MANAGER
                    bool "Storage partition manager module log verbosity"
                    default LOG_DEFAULT_LEVEL_STORAGE_PARTITION_MANAGER_EQUALS_DEFAULT
                    help
                        Specify how much output to see in logs by default in the Storage partition manager module.

                    config LOG_DEFAULT_LEVEL_STORAGE_PARTITION_MANAGER_EQUALS_DEFAULT
                        bool "Same as PurifyMyWater default"
                    config LOG_DEFAULT_LEVEL_STORAGE_PARTITION_MANAGER_NONE
                        bool "No output"
                    config LOG_DEFAULT_LEVEL_STORAGE_PARTITION_MANAGER_ERROR
                        bool "Error"
                        depends on LOG_MAXIMUM_LEVEL >= 1
                    config LOG_DEFAULT_LEVEL_STORAGE_PARTITION_MANAGER_WARN
                        bool "Warning"
                        depends on LOG_MAXIMUM_LEVEL >= 2
                    config LOG_DEFAULT_LEVEL_STORAGE_PARTITION_MANAGER_INFO
                        bool "Info"
                        depends on LOG_MAXIMUM_LEVEL >= 3
                    config LOG_DEFAULT_LEVEL_STORAGE_PARTITION_MANAGER_DEBUG
                        bool "Debug"
                        depends on LOG_MAXIMUM_LEVEL >= 4
                    config LOG_DEFAULT_LEVEL_STORAGE_PARTITION_MANAGER_VERBOSE
                        bool "Verbose"
                        depends on LOG_MAXIMUM_LEVEL >= 5

                endchoice

                config LOG_DEFAULT_LEVEL_STORAGE_PARTITION_MANAGER
                        int
                        default LOG_DEFAULT_LEVEL_PMW if LOG_DEFAULT_LEVEL_STORAGE_PARTITION_MANAGER_EQUALS_DEFAULT
                        default 0 if LOG_DEFAULT_LEVEL_STORAGE_PARTITION_MANAGER_NONE
                        default 1 if LOG_DEFAULT_LEVEL_STORAGE_PARTITION_MANAGER_ERROR
                        default 2 if LOG_DEFAULT_LEVEL_STORAGE_PARTITION_MANAGER_WARN
                        default 3 if LOG_DEFAULT_LEVEL_STORAGE_PARTITION_MANAGER_INFO
                        default 4 if LOG_DEFAULT_LEVEL_STORAGE_PARTITION_MANAGER_DEBUG
                        default 5 if LOG_DEFAULT_LEVEL_STORAGE_PARTITION_MANAGER_VERBOSE

    config LOG_COLORS
        bool "Use ANSI terminal colors in log output"
        default "y"
        help
            Enable ANSI terminal color codes in bootloader output.

            In order to view these, your terminal program must support ANSI color codes.

endmenu
```
