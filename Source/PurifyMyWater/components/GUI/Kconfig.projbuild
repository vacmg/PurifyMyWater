## Source/PurifyMyWater/components/SettingsStorage/Kconfig.projbuild
```kconfig
menu "PurifyMyWater Settings Configuration"

config SETTINGS_DISABLE_WRITE_TO_FLASH
    bool "Disable Writing to Flash"
    default n
    help
      Set this option to true to disable writing configuration to flash.
      This can be useful to preserve flash life in testing scenarios.

config SETTINGS_DISABLE_DELAYED_WRITE
    bool "Disable Delayed Write"
    default n
    help
      Set this option to true to disable delayed writing of the configuration.
      It will instead apply a write-through policy when changing settings

config SETTINGS_RETARDED_SAVE_TIME_MS
    int "Retarded Save Time (in milliseconds)"
    default 300000
    depends on !SETTINGS_DISABLE_DELAYED_WRITE
    help
      Set the time delay (in milliseconds) for delayed configuration saves.

endmenu
```

## Source/PurifyMyWater/main/Kconfig.projbuild
```kconfig
menu "PurifyMyWater Device Configuration"

    choice PARTITION_TABLE_TYPE
        prompt "Partition Table"
        default PARTITION_TABLE_SINGLE_APP
        help
            The partition table to flash to the ESP32. The partition table
            determines where apps, data and other resources are expected to
            be found.

            The predefined partition table CSV descriptions can be found
            in the components/partition_table directory. These are mostly intended
            for example and development use, it's expect that for production use you
            will copy one of these CSV files and create a custom partition CSV for
            your application.

        config PARTITION_TABLE_SINGLE_APP
            bool "Single factory app, no OTA"
            help
                This is the default partition table, designed to fit into a 2MB or
                larger flash with a single 1MB app partition.

                The corresponding CSV file in the IDF directory is
                components/partition_table/partitions_singleapp.csv

                This partition table is not suitable for an app that needs OTA
                (over the air update) capability.
        config PARTITION_TABLE_SINGLE_APP_LARGE
            bool "Single factory app (large), no OTA"
            help
                This is a variation of the default partition table, that expands
                the 1MB app partition size to 1.5MB to fit more code.

                The corresponding CSV file in the IDF directory is
                components/partition_table/partitions_singleapp_large.csv

                This partition table is not suitable for an app that needs OTA
                (over the air update) capability.
        config PARTITION_TABLE_TWO_OTA
            bool "Factory app, two OTA definitions"
            help
                This is a basic OTA-enabled partition table with a factory app
                partition plus two OTA app partitions. All are 1MB, so this
                partition table requires 4MB or larger flash size.

                The corresponding CSV file in the IDF directory is
                components/partition_table/partitions_two_ota.csv
        config PARTITION_TABLE_CUSTOM
            bool "Custom partition table CSV"
            help
                Specify the path to the partition table CSV to use for your project.

                Consult the Partition Table section in the ESP-IDF Programmers Guide
                for more information.
        config PARTITION_TABLE_SINGLE_APP_ENCRYPTED_NVS
            bool "Single factory app, no OTA, encrypted NVS"
            depends on !ESP32_COREDUMP_ENABLE_TO_FLASH && NVS_ENCRYPTION
            help
                This is a variation of the default "Single factory app, no OTA" partition table
                that supports encrypted NVS when using flash encryption. See the Flash Encryption section
                in the ESP-IDF Programmers Guide for more information.

                The corresponding CSV file in the IDF directory is
                components/partition_table/partitions_singleapp_encr_nvs.csv
        config PARTITION_TABLE_SINGLE_APP_LARGE_ENC_NVS
            bool "Single factory app (large), no OTA, encrypted NVS"
            depends on !ESP32_COREDUMP_ENABLE_TO_FLASH && NVS_ENCRYPTION
            help
                This is a variation of the "Single factory app (large), no OTA" partition table
                that supports encrypted NVS when using flash encryption. See the Flash Encryption section
                in the ESP-IDF Programmers Guide for more information.

                The corresponding CSV file in the IDF directory is
                components/partition_table/partitions_singleapp_large_encr_nvs.csv
        config PARTITION_TABLE_TWO_OTA_ENCRYPTED_NVS
            bool "Factory app, two OTA definitions, encrypted NVS"
            depends on !ESP_COREDUMP_ENABLE_TO_FLASH && NVS_ENCRYPTION
            help
                This is a variation of the "Factory app, two OTA definitions" partition table
                that supports encrypted NVS when using flash encryption. See the Flash Encryption section
                in the ESP-IDF Programmers Guide for more information.

                The corresponding CSV file in the IDF directory is
                components/partition_table/partitions_two_ota_encr_nvs.csv
        endchoice
        
    config PARTITION_TABLE_CUSTOM_FILENAME
        string "Custom partition CSV file" if PARTITION_TABLE_CUSTOM
        help
            Name of the custom partition CSV filename. This path is evaluated
            relative to the project root directory.
    
    choice ESPTOOLPY_FLASHSIZE
        prompt "Flash size"
        help
            SPI flash size, in megabytes
    endchoice

    config STORAGE_PARTITION_LABEL
        string "Storage Partition Label"
        default "storage"
        help
            The label of the partition to use for storage. This partition must be
            defined in the partition table CSV file.

endmenu
```
